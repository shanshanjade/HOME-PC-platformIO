#include <Arduino.h>
#include <Adafruit_GFX.h>
#include <Adafruit_NeoMatrix.h>
#include <Adafruit_NeoPixel.h>
#include <Ticker.h>


#define PIN D3

const uint8_t ApcFont35Bitmaps[] PROGMEM = {
    0x00,                               /* 0x20 space */
    0x80, 0x80, 0x80, 0x00, 0x80,       /* 0x21 exclam */
    0xA0, 0xA0,                         /* 0x22 quotedbl */
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    0x60, 0xC0,                         /* 0x7E asciitilde */
};
/* {offset, width, height, advance cursor, x offset, y offset} */
const GFXglyph ApcFont35Glyphs[] PROGMEM = {
    {0, 8, 1, 2, 0, -5},   /* 0x20 space */
    {1, 8, 5, 2, 0, -5},   /* 0x21 exclam */
    {6, 8, 2, 4, 0, -5},   /* 0x22 quotedbl */
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    {416, 8, 2, 4, 0, -5}, /* 0x7E asciitilde */
};
const GFXfont ApcFont35 PROGMEM = {(uint8_t *)ApcFont35Bitmaps,(GFXglyph *)ApcFont35Glyphs, 0x20, 0x7E, 6};

Adafruit_NeoMatrix matrix = Adafruit_NeoMatrix(32, 8, PIN,
  NEO_MATRIX_TOP     + NEO_MATRIX_LEFT +
  NEO_MATRIX_COLUMNS + NEO_MATRIX_ZIGZAG,
  NEO_GRB            + NEO_KHZ800);
const uint16_t colors[] = { matrix.Color(255, 0, 0), matrix.Color(0, 255, 0), matrix.Color(0, 0, 255) };

const uint8_t myGif[5000] PROGMEM= {
  0x08,
  0x08,
  0xff,
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  B11100000,B10100000,B11100000,B00100000,B11100000,B00000000,B00000000,B00000000,//9
};

const uint8_t six[] PROGMEM= {
    B11100000,B10000000,B11100000,B10100000,B11100000,B00000000,B00000000,B00000000//
};

const unsigned char gImage_ant[2056] PROGMEM= { 0X00,0X10,0X20,0X00,0X20,0X00,0X01,0X1B,
0XFF,0XFF,0XFF,0XFF,0XFF,0XFF,0XFF,0XFF,0XFF,0XFF,0XFF,0XFF,0XFF,0XFF,0XFF,0XFF,
0XFF,0XFF,0XFF,0XFF,0XFF,0XFF,0XFF,0XFF,0XFF,0XFF,0XFF,0XFF,0XFF,0XFF,0XFF,0XFF,
0XFF,0XFF,0XFF,0XFF,0XFF,0XFF,0XFF,0XFF,0XFF,0XFF,0XFF,0XFF,0XFF,0XFF,0XFF,0XFF,
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0XFF,0XFF,0XFF,0XFF,0XFF,0XFF,0XFF,0XFF,0XFF,0XFF,0XFF,0XFF,0XFF,0XFF,0XFF,0XFF,
};

const unsigned char gImage_cow[2056] PROGMEM= { 0X00,0X10,0X20,0X00,0X20,0X00,0X01,0X1B,
0XBE,0XF7,0XBE,0XF7,0XBE,0XF7,0XBE,0XF7,0X00,0X78,0XBE,0XF7,0XBE,0XF7,0XBE,0XF7,
0XBE,0XF7,0XBE,0XF7,0XBE,0XF7,0XBE,0XF7,0XBE,0XF7,0XBE,0XF7,0XBE,0XF7,0XBE,0XF7,
0XBE,0XF7,0XBE,0XF7,0XBE,0XF7,0XBE,0XF7,0XBE,0XF7,0XBE,0XF7,0XBE,0XF7,0XBE,0XF7,
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0XBE,0XF7,0XBE,0XF7,0XBE,0XF7,0XBE,0XF7,0XBE,0XF7,0XBE,0XF7,0XBE,0XF7,0XBE,0XF7,
};

const unsigned char gImage_doctor[2632] PROGMEM= { 0X00,0X10,0X20,0X00,0X29,0X00,0X01,0X1B,
0XFF,0XFF,0XFF,0XFF,0XFF,0XFF,0XFF,0XFF,0XFF,0XFF,0XFF,0XFF,0XFF,0XFF,0XFF,0XFF,
0XFF,0XFF,0XFF,0XFF,0XFF,0XFF,0XFF,0XFF,0XFF,0XFF,0X3C,0XE7,0X71,0X8C,0X4A,0X4A,
0X08,0X3A,0X0D,0X63,0X8E,0X6B,0XC4,0X18,0X00,0X00,0XC3,0X18,0XD0,0X7B,0XBE,0XF7,
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0X0C,0X63,0XBF,0XFF,0XFF,0XFF,0XFF,0XFF,0XFF,0XFF,0XFF,0XFF,0XFF,0XFF,0X00,0X00,
};

const unsigned char gImage_wechat[2056] PROGMEM= { 0X00,0X10,0X20,0X00,0X20,0X00,0X01,0X1B,
0XFF,0XFF,0XFE,0XFF,0XFF,0XFF,0X51,0X8F,0X64,0X16,0XC3,0X0E,0XC3,0X16,0XA3,0X16,
0XC3,0X16,0XA3,0X16,0XA3,0X16,0XA3,0X16,0XA3,0X16,0XC3,0X16,0XA3,0X16,0XC3,0X16,
0XA3,0X16,0XA3,0X16,0XA3,0X16,0XA3,0X16,0XA3,0X16,0XA3,0X16,0XA3,0X16,0XA3,0X16,
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0XA3,0X15,0X82,0X15,0X83,0X15,0X89,0X45,0XFF,0XFF,0XFF,0XFF,0XFF,0XFF,0XFF,0XFF,
};

void drawWeek(uint8_t _week){
  matrix.drawLine(1,7,3,7,0x001F);
  matrix.drawLine(5,7,7,7,0x001F);
  matrix.drawLine(9,7,11,7,0x001F);
  matrix.drawLine(13,7,15,7,0x001F);
  matrix.drawLine(17,7,19,7,0x001F);
  matrix.drawLine(22,7,25,7,0X07E0);
  matrix.drawLine(27,7,30,7,0X07E0);
  switch( _week){
    case 0:
      matrix.drawLine(1,7,3,7,0xf800);
      break;
    case 1:
      matrix.drawLine(5,7,7,7,0xf800);
      break;
    case 2:
      matrix.drawLine(9,7,11,7,0xf800);
      break;
    case 3:
      matrix.drawLine(13,7,15,7,0xf800);
      break;
    case 4:
      matrix.drawLine(17,7,19,7,0xf800);
      break;
    case 5:
      matrix.drawLine(22,7,25,7,0xf800);
      break;
    case 6:
      matrix.drawLine(27,7,30,7,0xf800);
      break;
  }
}

void drawBitGIF(const uint8_t *_GIF){
  matrix.fill(0);
  uint8_t width = pgm_read_byte(&_GIF[0]);
  uint8_t height = pgm_read_byte(&_GIF[1]);
  uint8_t gifDelay = pgm_read_byte(&_GIF[2]);
  uint8_t picNum = pgm_read_byte(&_GIF[3]);
  uint8_t gifData[height*picNum];

  for(int i = 0; i < height*picNum ; i++){
    gifData[i] = pgm_read_byte(&_GIF[4+i]);
  }
  static uint8_t frameNum = 0;

  uint8_t frame[height];
  for (int i = 0; i < height; i++)
  {
    frame[i] = gifData[8*frameNum + i]; 
  }
  frameNum++;
  if(frameNum >= picNum) frameNum = 0;
  
  matrix.drawBitmap(0,0,frame,width,height,matrix.Color(0,255,0));
  Serial.println(frameNum);
  matrix.show();
  delay(gifDelay*5);
}

uint16_t buffer[15000];

uint16_t *rgbBitmap;

struct imageInfo
{
  int8_t width;
  int8_t height;
  uint8_t frameNum;
  uint16_t delayms;
} rgbBMPInfo;

Ticker myticker;

uint8_t week = 0;
int y= 0;
int8_t flag = -1;

uint16_t *u8to16_PGM(const unsigned char u8arr[]){
  rgbBMPInfo.width = pgm_read_word(&u8arr[2]);
  rgbBMPInfo.height = pgm_read_word(&u8arr[4]);
  uint16_t *arr16 = (uint16_t *)memcpy_P(buffer,&u8arr[8],rgbBMPInfo.width*rgbBMPInfo.height*2);
  return arr16;
}
void changeBMP(){
    static uint8_t BMPindex = 0;
    switch(BMPindex%4){
    case 0 : 
      rgbBitmap = u8to16_PGM(gImage_wechat);
      break;
    case 1 :
      rgbBitmap = u8to16_PGM(gImage_doctor);
      break;
    case 2 :
      rgbBitmap = u8to16_PGM(gImage_cow);
      break;
    case 3 :
      rgbBitmap = u8to16_PGM(gImage_ant);
      break;
  }
  BMPindex++;
  y = 0;
  flag = -1;
}

void setup() {
  Serial.begin(115200);
  matrix.begin();

  myticker.attach(30,changeBMP);
  matrix.setBrightness(10);
  matrix.setTextWrap(false);
  matrix.setTextColor(colors[0]);
  matrix.setFont(&ApcFont35);
  matrix.setCursor(0,8);
  matrix.print("   ARTRIX");
  matrix.show();
  delay(2000);
  matrix.drawBitmap(0,0,six,7,8,matrix.Color(0,255,0));
  matrix.show();
  delay(2000);
  rgbBitmap = u8to16_PGM(gImage_doctor);
}



void loop() {
  matrix.clear();
  
  matrix.drawRGBBitmap(0,y,rgbBitmap,rgbBMPInfo.width,rgbBMPInfo.height);
  // matrix.setCursor(2,6);
  // matrix.print("22:44:58");
  // drawWeek(week);
  matrix.show();
  y=y+flag ;if(y < -rgbBMPInfo.height+9 || y > -1)flag = -flag ;
  Serial.println(y);
  delay(50);
  // drawBitGIF(myGif);
  // yield();
}
